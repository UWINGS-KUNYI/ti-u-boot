## board/forlinx/ok6254c/Kconfig
```kconfig
# SPDX-License-Identifier: GPL-2.0+
#
# Copyright (C) 2022 UWINGS TECHNOLOGIES
#	KunYi Chen <kunyi.chen@gmail.com>

choice
	prompt "Forlinx TI K3-AM62x based boards"
	optional

config TARGET_OK6254C
	bool "TI K3 based AM6254 running on A53"
	select ARM64
	select SOC_K3_AM625
	imply BOARD
	imply SPL_BOARD


config TARGET_OK6254C_R5
	bool "TI K3 based AM6254 running on R5"
	select CPU_V7R
	select SYS_THUMB_BUILD
	select K3_LOAD_SYSFW
	select SOC_K3_AM625
	select RAM
	select SPL_RAM
	select K3_DDRSS
	imply SYS_K3_SPL_ATF

endchoice

if TARGET_OK6254C

config SYS_BOARD
       default "ok6254c"

config SYS_VENDOR
       default "forlinx"

config SYS_CONFIG_NAME
       default "ok6254c"

source "board/ti/common/Kconfig"

endif

if TARGET_OK6254C_R5

config SYS_BOARD
       default "ok6254c"

config SYS_VENDOR
       default "forlinx"

config SYS_CONFIG_NAME
       default "ok6254c"

config SPL_LDSCRIPT
	default "arch/arm/mach-omap2/u-boot-spl.lds"

source "board/ti/common/Kconfig"

endif
```
